//Biblioteki
#include <Arduino.h>
#include <SPI.h>
#include <U8g2lib.h>
#include <Wire.h>
#include <BMP280_DEV.h>                         
#include <Adafruit_SGP30.h>

// Piny do BSM baterii
const int analogInPin = A0;
#define BATTERY 2
#define BATTERY_CHARGE 16


// Piny przycisków
#define RIGHT_B 12  // przycisk do poruszania menu w prawo
#define LEFT_B 13     // przycisk do poruszania menu w lewo
#define OK_B 14       // przycisk OK do egzekucji danej pozycji menu
#define CANCEL_B 15   // przycisk powrotu do poprzedniej wartości menu lub wyjścia z dajego polecenia

// Kontruktor obiektów
U8G2_SSD1306_128X32_UNIVISION_F_HW_I2C u8g2_S(U8G2_R0); // I2C 0x3C
U8G2_SSD1306_128X64_NONAME_F_HW_I2C u8g2_L(U8G2_R2); // I2C 0x3D
BMP280_DEV bmp280; // I2C 0x77                                
Adafruit_SGP30 sgp; // I2C 0x??

// Zmienne pomiarowe
float temperature, pressure, altitude; // BSP280
int tvoc, eCO2; // SGP30
int battery_voltage; // Do BMS
int wynik;

byte idPomiaru = 0;

int stanBaterii = 5;
byte bateriaDelay = 0;
int pomiarBaterii = 0;
int stanTemp = 0;
int stanCount = 0;

// Zmienne wyświetlacza
float minVal, maxVal, v;
float punkt;
String nazwaPomiaru;

// Rozmiary dla obrazków
#define meatCheckW 54
#define meatCheckH 44
#define logo60 60
#define ikona12 12
#define exW 70
#define exH 48
#define bateriaW 28
#define bateriaH 18
#define navIkonaW 9
#define navIkonaH 6
#define OPDProz 56

// Obrazki w formacie XBM
static const unsigned char  meatCheckLogo[] U8X8_PROGMEM =  {  
  0x00, 0x00, 0x00, 0xFF, 0xFF, 0x00, 0x00, 0x00, 0x00, 0xE0, 0xFF, 0xFF, 
  0x07, 0x00, 0x00, 0x00, 0xFC, 0xFF, 0xFF, 0x1F, 0x00, 0x00, 0x00, 0xFF, 
  0x07, 0xC0, 0x3F, 0x00, 0x00, 0x80, 0x7F, 0x00, 0x00, 0x7F, 0x00, 0x00, 
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  0x00, 0x00, 0x00, 0x00, 0x80, 0xFF, 0x0F, 0x00,  };

static const unsigned char  NOTlogo[] U8X8_PROGMEM ={
  0x00, 0x00, 0x80, 0x01, 0x18, 0x00, 0x00, 0x00, 0x00, 0x00, 0xF0, 0x01, 
  0xF8, 0x00, 0x00, 0x00, 0x00, 0x00, 0xFE, 0x03, 0xFC, 0x07, 0x00, 0x00, 
  0x00, 0x00, 0xFF, 0xFF, 0xFF, 0x0F, 0x00, 0x00, 0x00, 0x00, 0xFF, 0xFF, 
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  0xF8, 0x00, 0x00, 0x00, 0x00, 0x00, 0x80, 0x01, 0x18, 0x00, 0x00, 0x00,  };

static const unsigned char  exLogo[] U8X8_PROGMEM = {
  0x00, 0x30, 0x00, 0x00, 0x00, 0x00, 0x00, 0x03, 0x00, 0x00, 0x3C, 0x00, 
  0x00, 0x00, 0x00, 0x00, 0x0F, 0x00, 0x00, 0x3E, 0x00, 0x00, 0x00, 0x00, 
  0x00, 0x1F, 0x00, 0x00, 0x3F, 0x00, 0x00, 0x00, 0x00, 0x00, 0x3F, 0x00, 
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  0x00, 0x0F, 0x00, 0x00, 0x30, 0x00, 0x00, 0x00, 0x00, 0x00, 0x03, 0x00, 
  };

static const unsigned char ElektronikLogo[] U8X8_PROGMEM = {
  0x00, 0x00, 0x00, 0x00, 0x00, 0x00, 0x00, 0x00, 0x00, 0x00, 0xFE, 0x00, 
  0x00, 0x00, 0x00, 0x00, 0x00, 0x00, 0xFF, 0x07, 0x00, 0x00, 0x00, 0x00, 
  0x00, 0x80, 0xC7, 0x3F, 0x00, 0x00, 0x00, 0x00, 0x00, 0xC0, 0x03, 0xFE, 
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  0xFF, 0x01, 0x00, 0x00, 0x00, 0x00, 0x00, 0x00, 0xFC, 0x00, 0x00, 0x00, 
  };


static const unsigned char OPDP[] U8X8_PROGMEM = {
  0x00, 0x00, 0x00, 0x7E, 0x00, 0x00, 0x00, 0x00, 0x00, 0x00, 0x7E, 0x00, 
  0x00, 0x00, 0x00, 0xC0, 0x01, 0x7E, 0x80, 0x03, 0x00, 0x00, 0xF0, 0x03, 
  0x7E, 0xC0, 0x0F, 0x00, 0x00, 0xF8, 0x07, 0x7E, 0xE0, 0x1F, 0x00, 0x00, 
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  0x00, 0x00, 0x00, 0x00, 0x7E, 0x00, 0x00, 0x00, };

static const unsigned char bateria[] U8X8_PROGMEM = {
  0xF8, 0xFF, 0xFF, 0x07, 0xFC, 0xFF, 0xFF, 0x0F, 0x0C, 0x00, 0x00, 0x0C, 
  0x0C, 0x00, 0x00, 0x0C, 0x0C, 0x00, 0x00, 0x0C, 0x0C, 0x00, 0x00, 0x0C, 
  0x0F, 0x00, 0x00, 0x0C, 0x0F, 0x00, 0x00, 0x0C, 0x0F, 0x00, 0x00, 0x0C, 
  0x0F, 0x00, 0x00, 0x0C, 0x0F, 0x00, 0x00, 0x0C, 0x0F, 0x00, 0x00, 0x0C, 
  0x0C, 0x00, 0x00, 0x0C, 0x0C, 0x00, 0x00, 0x0C, 0x0C, 0x00, 0x00, 0x0C, 
  0x0C, 0x00, 0x00, 0x0C, 0xFC, 0xFF, 0xFF, 0x0F, 0xF8, 0xFF, 0xFF, 0x07, 
  };

static const unsigned char mieso[] U8X8_PROGMEM = {
  0x00, 0x00, 0xE0, 0x03, 0x18, 0x04, 0x04, 0x04, 0x82, 0x08, 0xC1, 0x09, 
  0x81, 0x08, 0x01, 0x08, 0x01, 0x08, 0x79, 0x0C, 0xFF, 0x0F, 0xCE, 0x07, 
  };

static const unsigned char mucha[] U8X8_PROGMEM = {
  0x00, 0x02, 0x38, 0x03, 0xC6, 0x0F, 0x81, 0x07, 0x81, 0x03, 0x43, 0x02, 
  0x3C, 0x04, 0x3E, 0x04, 0x3F, 0x04, 0x3F, 0x02, 0x5E, 0x02, 0xCC, 0x01, 
  };

static const unsigned char navOK[] U8X8_PROGMEM = {
  0x26, 0x01, 0xA9, 0x00, 0x69, 0x00, 0x69, 0x00, 0xA9, 0x00, 0x26, 0x01,
  };

static const unsigned char navPowrot[] U8X8_PROGMEM = {
  0x04, 0x00, 0x06, 0x00, 0xFF, 0x00, 0xFF, 0x01, 0x86, 0x01, 0xC4, 0x00, 
  };


// MENU
// Stałe w menu

const char menu0[] PROGMEM = "Menu główne";

const char menu2_1_1[] PROGMEM = "Szynka gotowana";
const char menu2_1_2[] PROGMEM = "Szynka konserwowa";
const char menu2_1_3[] PROGMEM = "Szynka wędzona";
const char menu2_1_4[] PROGMEM = "Mielonka tyrolska";

const char menu2_2_1[] PROGMEM = "Filet";
const char menu2_2_2[] PROGMEM = "Wątróbka";
const char menu2_2_3[] PROGMEM = "Udka, podudzia itp.";

const char menu2_3_1[] PROGMEM = "Karkówka";
const char menu2_3_2[] PROGMEM = "Polędwica";
const char menu2_3_3[] PROGMEM = "Podroby wołowe";
const char menu2_3_4[] PROGMEM = "Inne";

const char menu2_4_1[] PROGMEM = "Schab";
const char menu2_4_2[] PROGMEM = "Boczek";
const char menu2_4_3[] PROGMEM = "Szynka";
const char menu2_4_4[] PROGMEM = "Łopatka";
const char menu2_4_5[] PROGMEM = "Inne";

const char menu2_5_1[] PROGMEM = "Ryba słodka";
const char menu2_5_2[] PROGMEM = "Ryba słona";
const char menu2_5_3[] PROGMEM = "Ryba marynowana";


const char menu2_1[] PROGMEM = "Wędlina";
const char menu2_2[] PROGMEM = "Kurczak";
const char menu2_3[] PROGMEM = "Wołowina";
const char menu2_4[] PROGMEM = "Wieprzowina";
const char menu2_5[] PROGMEM = "Ryba";

const char menu3_1[] PROGMEM = "Serwer WiFi";
const char menu3_2[] PROGMEM = "Debugowanie";

const char menu1[] PROGMEM = "Pomiar na żywo";
const char menu2[] PROGMEM = "Wybór mięs";
const char menu3[] PROGMEM = "Ustawienia";
const char menu4[] PROGMEM = "Wyłącz urządzenie";

// Lista pozycji menu ułożona zgodnie z indeksami

const char *const listaMenu[] PROGMEM = {
  menu1, menu2, menu3, menu4,
    menu2_1, menu2_2, menu2_3, menu2_4, menu2_5,
      menu2_1_1, menu2_1_2, menu2_1_3, menu2_1_4,
      menu2_2_1, menu2_2_2, menu2_2_3,
      menu2_3_1, menu2_3_2, menu2_3_3, menu2_3_4,
      menu2_4_1, menu2_4_2, menu2_4_3, menu2_4_4, menu2_4_5,
      menu2_5_1, menu2_5_2, menu2_5_3,
    menu3_1, menu3_2
};

// Lista każdego subemu drzewa

const char *const listaSubmenu[] PROGMEM = {
  menu0,
    menu2,
      menu2_1, menu2_2, menu2_3, menu2_4, menu2_5,
    menu3  
};


// Dla szybszego wykonywania programu i uniknięcia błędów stałe rozmiarów menu są zapisane w pamięci SRAM

const int indeksy[20] = {
  0, 4, 9, 13, 16, 20, 25, 28 
};

const int rozmiary[20] = {
  4, 5, 4, 3, 4, 5, 3, 2
};


// Zmienna uniemożliwiajaca wykonywanie inputu w pętli, nie można używać kilku przycisków naraz kosztem przejrzystosci i intuicyjnosci

byte inputDelay = 0;

// Zmienne pamiętające indeks danego submenu

int poziom1 = -1;
int poziom2 = -1;

// Zmienne indeksujące

int menuRozmiar;
int menuIndeks;
int menuPozycja;
int indeks;

// Zmienna wyłącznika urządzenia

bool wylacznik;


// FUNKCJE
// Zwracaniie pozycji w menu

int pozycja(int stanObecny, int indeks, int rozmiar){
  
  if (digitalRead(RIGHT_B) == LOW){
    inputDelay = RIGHT_B; 
    if (stanObecny >= indeks + rozmiar - 1){
      return indeks;
    }
    else{
      stanObecny++;
      return stanObecny;
    }
  }
  if (digitalRead(LEFT_B) == LOW){
    inputDelay = LEFT_B;
    if (stanObecny <= indeks){
       return indeks + rozmiar - 1;
    }
    else{
       stanObecny--;
       return stanObecny;
    }
  }
  return(stanObecny);
}



int menuNawigacja(){
  
  if (digitalRead(OK_B) == LOW){
      inputDelay = OK_B; 
      return 1;
  }
    
  if (digitalRead(CANCEL_B) == HIGH){
    inputDelay = CANCEL_B;
    if (poziom1 == -1){  
      return 0;
    }else if (poziom2 == -1){
      indeks = poziom1;
      poziom1 = -1;
      return 2;
    }
    else
    {
      indeks = poziom2;
      poziom2 = -1;
      return 2;
    }
  }
  return 0;
}

// Funkcja wykonywana dla komendy która ma być wywołaniem i aktualizacją submenu

void nawigacjaSubmenu(int temp){
   menuIndeks = indeksy[temp];
   menuRozmiar = rozmiary[temp];
   menuPozycja = menuIndeks;
   if (poziom1 == -1){
     poziom1 = indeks;  
   }else if (poziom2 == -1){
     poziom2 = indeks;
 }
    indeks = temp;
}

// Opcja printująca pozycje menu zapisane w pamięci PROGMEM

char buffer[22];

char* printStringow(byte id){
  strcpy_P(buffer, (char *)pgm_read_dword(&(listaMenu[id])));
  return buffer;
}

char* printNazwyMenu(byte id){
  strcpy_P(buffer, (char *)pgm_read_dword(&(listaSubmenu[id])));
  return buffer;
}



// Skrypt aktywujący dane polecenie zgodnie z listą

void aktywacjaSkryptu(int id){
  switch(id){
    case 0:
      minVal = 50;
      maxVal = 1050;
      nazwaPomiaru = "Na żywo";
      while (digitalRead(CANCEL_B) == LOW){
        rysunekPomiaru();
      }
      delay(50);
      break;        
    case 1:
      nawigacjaSubmenu(1);
      break;      
    case 2:
      nawigacjaSubmenu(7);
      break; 
    case 3:
      while (digitalRead(OK_B) == LOW){
        rysunekWylacznika();
      }
      wylacznik = false;
      while (digitalRead(CANCEL_B) == LOW){
        rysunekWylacznika();
        if (digitalRead(OK_B) == LOW){
          break;
        }
      }
      if (wylacznik == true and digitalRead(OK_B) == LOW){
        wylaczanie(0);
      }
      while (digitalRead(CANCEL_B) == HIGH or digitalRead(OK_B) == LOW){}
      break;  
    case 4:
      nawigacjaSubmenu(2);
      break;      
    case 5:
      nawigacjaSubmenu(3);
      break;      
    case 6:
      nawigacjaSubmenu(4);
      break;      
    case 7:
      nawigacjaSubmenu(5);
      break;
    case 8:
      nawigacjaSubmenu(6);
      break;
    case 9:
       break;
    case 10:
      break;      
    case 11:
      break;
    case 12:
      break;
    case 13:
      break;
    case 14:
      break;
    case 15:
      break;
    case 16:
      break;
    case 17:
      break;
    case 18:
      break;    
    case 19:
      break;
    case 20:
      break;      
    case 21:
      break;
    case 22:
      break;
    case 23:
      break;
    case 24:
      break;
    case 25:
      break;
    case 26:
      break;
    case 27:
      break;
    case 28:
      break;  
    case 29:
      u8g2_L.clearBuffer();
      u8g2_L.sendBuffer();
      int temp = 0;
      while (digitalRead(CANCEL_B) == LOW){
        if (temp < 40){
          temp++;
          delay(1);
        }
        else{
          temperatura();
          rysunekGorny(0);
          u8g2_L.clearBuffer();
          u8g2_L.drawButtonUTF8(0, 12, U8G2_BTN_BW0, 0,  1,  1, "TVOC:");
          u8g2_L.drawButtonUTF8(85, 12, U8G2_BTN_BW0, 0,  1,  1, String(pomiar()).c_str());
          u8g2_L.drawButtonUTF8(0, 24, U8G2_BTN_BW0, 0,  1,  1, "Baterry:");
          u8g2_L.drawButtonUTF8(85, 24, U8G2_BTN_BW0, 0,  1,  1, String(pomiarNapieciaBaterii()).c_str());
//          u8g2_L.drawButtonUTF8(0, 36, U8G2_BTN_BW0, 0,  1,  1, "Temp.:");
//          u8g2_L.drawButtonUTF8(85, 36, U8G2_BTN_BW0, 0,  1,  1, String(temperature).c_str());
          u8g2_L.sendBuffer();
          
        }
      }
      break;
  }
}



// FUNKCJE POMIAROWE

// Funkcja pomiaru napięcia baterii dla pomiaru czujnika oraz wydajności samej baterii

int pomiarNapieciaBaterii(){
  return analogRead(analogInPin);
}

// Funkcja pomiaru temperatury
void temperatura(){
  bmp280.startForcedConversion(); 
  bmp280.getMeasurements(temperature, pressure, altitude);
  return;
}



int pomiar() {
//  temperatura();
  sgp.IAQmeasure();
  tvoc =  sgp.TVOC;
  eCO2 = sgp.eCO2;
  switch (idPomiaru){
    case 0:
      wynik = tvoc;
      break;
    case 1:
      break;
  }
  return wynik;
}

void pomiarB(){
  if (digitalRead(BATTERY_CHARGE) == HIGH){
    if (bateriaDelay == 5){
      bateriaDelay = 0;
      switch (stanBaterii){
        case 5:
          stanBaterii = 0;
          break;
        default:
          stanBaterii++;
          break;
      }
    } else{
      bateriaDelay++;
    }
  } else{
    stanTemp = 0;
    pomiarBaterii = (pomiarNapieciaBaterii() - 900) / 18;
    if (pomiarBaterii < stanBaterii){
      stanCount++;
      if (stanCount = 5){
        stanBaterii = pomiarBaterii;
        stanCount = 0;
      }
    } else{
      stanCount = 0;
    }
    if (stanBaterii < 0){
      wylaczanie(1);
    }
    if (stanBaterii > 5){
      stanBaterii = 5;
    }
  }
  return;
  
}


// RYSOWANIE

// Rysowanie wstepnych logotypow przy bootowaniu

void rysunekWstep(int wybor){
  u8g2_L.clearBuffer();
  switch (wybor){
      case 0:
        u8g2_L.drawXBMP(34, 2, logo60,  logo60, NOTlogo);
        break;

      case 1:
        u8g2_L.drawXBMP(29, 8, exW, exH, exLogo);
        break;

      case 2:
        u8g2_L.drawXBMP(34, 2, logo60, logo60, ElektronikLogo);
        break;

      case 3:
        u8g2_L.drawXBMP(36, 4, OPDProz, OPDProz, OPDP);
        break;
        
      case 4:
          u8g2_L.drawXBMP(36, 2, meatCheckW, meatCheckH, meatCheckLogo);
          u8g2_L.drawStr(30,62,"MeatChech+");
          break;

  }
  u8g2_L.sendBuffer();
}

// Rysowanie oczekiwania na rozgrzanie czujnika i przygotowanie do pomiarów

void przygotowanie(){
  int number = 0;
  while (number <= 100){
    number++;
    u8g2_L.clearBuffer();
    u8g2_L.drawFrame(14,32,100,10);
    u8g2_L.drawBox(14,32,number, 10);
    u8g2_L.drawButtonUTF8(63, 20, U8G2_BTN_HCENTER|U8G2_BTN_BW0, 0,  1,  1, "Trwa rozgrzewanie" );
    u8g2_L.sendBuffer();
    delay(12);
  }
  return;
}

void rysunekGorny(int tryb){
  pomiarB();
  u8g2_S.clearBuffer();

  switch(tryb){
    case 0:
      u8g2_S.setDrawColor(1); 
      u8g2_S.drawXBMP(95, 7, bateriaW, bateriaH, bateria);
      for (int temp = 0; temp < stanBaterii; temp++){
          u8g2_S.drawBox((101 + temp*4), 10, 2, 12); 
      }

      // Inne dane

      
      break;
      
    case 1:
      u8g2_S.setFont(u8g2_font_Pixellari_tf);  
      u8g2_S.drawFrame(19,0,92,15);
      
      u8g2_S.setDrawColor(1); 
      int dlugosc = map(v, minVal, maxVal, 0, 90);
      int procent = map(v, minVal, maxVal, 0, 100);
      u8g2_S.drawBox(20,0,dlugosc,15);
      u8g2_S.drawXBMP(0, 1, ikona12, ikona12, mieso);
      u8g2_S.drawXBMP(116, 1, ikona12, ikona12, mucha);
      u8g2_S.drawButtonUTF8(63, 32, U8G2_BTN_HCENTER|U8G2_BTN_BW0, 0,  1,  1, String(String(procent) + "%").c_str() );
      u8g2_S.setFont(u8g2_font_bitcasual_t_all);  
      break;
  }
  u8g2_S.sendBuffer();
  
}


// Rysunek menu

void rysunekMenu() {
    rysunekGorny(0);
    u8g2_L.clearBuffer();
    u8g2_L.drawButtonUTF8(63, 38, U8G2_BTN_HCENTER|U8G2_BTN_BW0, 0,  1,  1, printStringow(menuPozycja));
    u8g2_L.drawButtonUTF8(63, 20, U8G2_BTN_HCENTER|U8G2_BTN_BW0, 0,  1,  1, printNazwyMenu(indeks));
    if (indeks != 0){
      u8g2_L.drawXBMP(0, 57, navIkonaW, navIkonaH, navPowrot);
    }
    u8g2_L.drawXBMP(118, 57, navIkonaW, navIkonaH, navOK);
    int kropkiMenu = 63 - (menuRozmiar - 1) * 3;
    int pozycjaMenu = menuPozycja - menuIndeks;
    for (int temp = 0; temp < menuRozmiar; temp++){
      u8g2_L.drawDisc(kropkiMenu,60,1, U8G2_DRAW_ALL );
      if (pozycjaMenu == temp){
        u8g2_L.drawDisc(kropkiMenu,60,2, U8G2_DRAW_ALL );
       }
      kropkiMenu = kropkiMenu + 6;
    }
    u8g2_L.sendBuffer();
}

// Logika dla pomiarów nie na żywo DO IMPLEMENTACJI

int skryptPomiaru(int id_pomiaru){

  switch(id_pomiaru){
    case 1:
        break;
    case 2:
        break;
    case 3:
        break;
    case 4:
        break;
    case 5:
        break;
    case 6:
        break;
    case 7:
        break;
    case 8:
        break;
    case 9:
        break;
    case 10:
        break;
    case 11:
        break;
    case 12:
        break;
    case 13:
        break;
    case 14:
        break;
    case 15:
        break;
    case 16:
        break;
    case 17:
        break;
    case 18:
        break;
    case 19:
        break;
  }
}

// Stringi do rysunku pomiaru

String tekstPomiaru(float dane, float minV, float maxV){
  float rozmiar = maxV - minV;
  int testPomiarowy = (dane - minV) / rozmiar * 2.65 - 0.35;
  switch (testPomiarowy){
    case 0:
      return "Produkt świeży";
    
    case 1:
      return "Produkt nieświeży";

    case 2:
      return "Produkt zepsuty";
  }
}

// Rysowanie miernika lub innych funkcji menu

void rysunekWylacznika(){
  rysunekGorny(0);
  if (digitalRead(RIGHT_B) == LOW or digitalRead(LEFT_B) == LOW){
      wylacznik = !wylacznik;
      while (digitalRead(RIGHT_B) == LOW or digitalRead(LEFT_B) == LOW){}
      delay(30);
  }
  u8g2_L.clearBuffer();
  u8g2_L.drawButtonUTF8(64, 16, U8G2_BTN_HCENTER|U8G2_BTN_BW0, 0,  1,  1, "Czy na pewno" );
  u8g2_L.drawButtonUTF8(64, 28, U8G2_BTN_HCENTER|U8G2_BTN_BW0, 0,  1,  1, "chcesz wyłączyć" );
  u8g2_L.drawButtonUTF8(64, 40, U8G2_BTN_HCENTER|U8G2_BTN_BW0, 0,  1,  1, "urządznie?" );
  u8g2_L.drawButtonUTF8(38, 61, U8G2_BTN_HCENTER|U8G2_BTN_BW0, 0,  1,  1, "Nie" );
  u8g2_L.drawButtonUTF8(88, 61, U8G2_BTN_HCENTER|U8G2_BTN_BW0, 0,  1,  1, "Tak" );
  u8g2_L.drawFrame(23 + wylacznik*49, 51, 29 + wylacznik*2, 13);
  u8g2_L.drawXBMP(118, 57, navIkonaW, navIkonaH, navOK);
  u8g2_L.sendBuffer();
}

void rysunekPomiaru() {
  pomiarB();
  v = pomiar();
  if (v < minVal){
     v = minVal;
  }   
  else if (v > maxVal){
     v = maxVal;
  }
  
  rysunekGorny(1);    
      
  u8g2_L.clearBuffer();
  u8g2_L.setDrawColor(1);
  u8g2_L.drawXBMP(0, 57, navIkonaW, navIkonaH, navPowrot);
  u8g2_L.drawButtonUTF8(64, 16, U8G2_BTN_HCENTER|U8G2_BTN_BW0, 0,  1,  1, "Tryb pomiaru:" );
  u8g2_L.drawButtonUTF8(64, 30, U8G2_BTN_HCENTER|U8G2_BTN_BW0, 0,  1,  1, nazwaPomiaru.c_str() );
  u8g2_L.drawButtonUTF8(64, 48, U8G2_BTN_HCENTER|U8G2_BTN_BW0, 0,  1,  1, tekstPomiaru(v, minVal, maxVal).c_str() );
  
  u8g2_L.sendBuffer();  

}

// Funkcja wyłączająca urządzenie

void wylaczanie(int wyl_id){
  u8g2_S.clearBuffer();
  u8g2_S.sendBuffer();
  u8g2_L.clearBuffer();
  
  switch (wyl_id){
    case 0:
      u8g2_L.drawButtonUTF8(64, 32, U8G2_BTN_HCENTER|U8G2_BTN_BW0, 0,  1,  1, "Wyłączanie..." );
      break;
    case 1:
      u8g2_L.drawButtonUTF8(64, 26, U8G2_BTN_HCENTER|U8G2_BTN_BW0, 0,  1,  1, "Bateria" );
      u8g2_L.drawButtonUTF8(64, 38, U8G2_BTN_HCENTER|U8G2_BTN_BW0, 0,  1,  1, "rozładowana" );
      break;
    
  }
  
  u8g2_L.sendBuffer();
  delay(1500);
  u8g2_L.clearBuffer();
  u8g2_L.sendBuffer();
  digitalWrite(BATTERY, HIGH);
  while(true){
    delay(5);
  }  
}


void setup() {
  // Aktywacja BSM
  pomiarB();
  pinMode(BATTERY, OUTPUT);
  digitalWrite(BATTERY, LOW);
  if (stanBaterii < 0){
     wylaczanie(1);
  }

  pinMode(BATTERY_CHARGE, INPUT); 

  // Inicjacja urządzeń
  
  u8g2_L.setI2CAddress(0x7A);
  u8g2_S.setI2CAddress(0x78);                         
  u8g2_L.begin();
  u8g2_L.setDrawColor(1);
  u8g2_L.setFont(u8g2_font_bitcasual_t_all);
  u8g2_S.begin();
  u8g2_S.setDrawColor(1);
  u8g2_S.setFont(u8g2_font_bitcasual_t_all);  
  bmp280.begin(); 
  sgp.begin();

  // Inicjacja przycisków
  
  pinMode(RIGHT_B, INPUT_PULLUP);
  pinMode(LEFT_B, INPUT_PULLUP);
  pinMode(OK_B, INPUT_PULLUP);
  pinMode(CANCEL_B, INPUT_PULLUP);

  // Rysunki

  u8g2_S.clearBuffer();
  u8g2_S.drawButtonUTF8(64, 12, U8G2_BTN_HCENTER|U8G2_BTN_BW0, 0,  1,  1, "Mateusz Bojarski" );
  u8g2_S.sendBuffer();

  for (byte i = 0; i < 5; i++){
    rysunekWstep(i);
    delay(750 + (int(i/4) *500));
  }    
   przygotowanie();
   menuPozycja = 0;
   menuIndeks = indeksy[0];
   menuRozmiar = rozmiary[0];
}


void loop() {
  bool pinLogic;
  if (inputDelay != 0){
    if (inputDelay == CANCEL_B){
      pinLogic = 0;
    } else{
      pinLogic = 1;
    }
    if (digitalRead(inputDelay) == pinLogic){
      inputDelay = 0;
      delay(10);
    }
  } else{
     menuPozycja = pozycja(menuPozycja, menuIndeks, menuRozmiar);
     int j = menuNawigacja();
    if (j == 1){
      aktywacjaSkryptu(menuPozycja);
    } else if (j == 2){
      menuIndeks = indeksy[indeks];
      menuRozmiar = rozmiary[indeks];
      menuPozycja = menuIndeks;   
    }
  }
  rysunekMenu();
  delay(1);
}
